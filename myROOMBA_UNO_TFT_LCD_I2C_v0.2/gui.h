#ifndef GUI_H
#define GUI_H
class gearbox
{
  public:
  gearbox(int lW, int hW, int gCirc) : linesWid(lW), gearCircR(gCirc), horLine(hW) {}
  gearbox() : linesWid(80), horLine(70), gearCircR(20) {}
  ~gearbox(){}

  void draw(int X, int Y)
  {
    /*
     * [1] [3]
     *  |   |
     *  |---|
     *  |   |
     * [2] [4]
     */
     // OSIE
     sx=X; sy=Y;
    tft.drawFastVLine( sx, sy, linesWid ,TFT_WHITE );
    tft.drawFastVLine( sx+horLine, sy, linesWid ,TFT_WHITE );
    tft.drawFastHLine( sx, sy+linesWid/2, horLine ,TFT_WHITE );

    //GALKI
    tft.fillCircle(sx, sy, gearCircR, TFT_RED);
    tft.setCursor(sx-fntLoff, sy-fntToff);
    tft.setTextColor(WHITE);  tft.setTextSize(1); tft.println("1");
    
    tft.fillCircle(sx, sy+linesWid, gearCircR, TFT_RED);
    tft.setCursor(sx-fntLoff, sy+linesWid-fntToff);
    tft.setTextColor(WHITE);  tft.setTextSize(1); tft.println("2");

    tft.fillCircle(sx+horLine, sy, gearCircR, TFT_RED);
    tft.setCursor(sx+horLine-fntLoff, sy-fntToff);
    tft.setTextColor(WHITE);  tft.setTextSize(1); tft.println("3");

    tft.fillCircle(sx+horLine, sy+linesWid, gearCircR, TFT_RED);
    tft.setCursor(sx+horLine-fntLoff, sy+linesWid-fntToff);
    tft.setTextColor(WHITE);  tft.setTextSize(1); tft.println("4");

    // Napis
    tft.setTextColor(WHITE); tft.setTextSize(1);
    tft.setCursor(sx+12, sy+linesWid/2-10);
    tft.print("GEAR");
  }

  void setGear(byte gr)
  {
    // Wylacz wszystkie begi
    tft.fillCircle(sx, sy, gearCircR, TFT_RED);
    tft.setCursor(sx-fntLoff, sy-fntToff);
    tft.setTextColor(WHITE);  tft.setTextSize(1); tft.println("1");
    
    tft.fillCircle(sx, sy+linesWid, gearCircR, TFT_RED);
    tft.setCursor(sx-fntLoff, sy+linesWid-fntToff);
    tft.setTextColor(WHITE);  tft.setTextSize(1); tft.println("2");

    tft.fillCircle(sx+horLine, sy, gearCircR, TFT_RED);
    tft.setCursor(sx+horLine-fntLoff, sy-fntToff);
    tft.setTextColor(WHITE);  tft.setTextSize(1); tft.println("3");

    tft.fillCircle(sx+horLine, sy+linesWid, gearCircR, TFT_RED);
    tft.setCursor(sx+horLine-fntLoff, sy+linesWid-fntToff);
    tft.setTextColor(WHITE);  tft.setTextSize(1); tft.println("4");
    switch(gr)
    {
      case 0:
      {
        tft.fillCircle(sx, sy, gearCircR, TFT_GREEN);
        tft.setCursor(sx-fntLoff, sy-fntToff);
        tft.setTextColor(BLACK);  tft.setTextSize(1); tft.println("1");
        break;
      }
      case 1:
      {
        tft.fillCircle(sx, sy+linesWid, gearCircR, TFT_GREEN);
        tft.setCursor(sx-fntLoff, sy+linesWid-fntToff);
        tft.setTextColor(BLACK);  tft.setTextSize(1); tft.println("2");
        break;
      }
      case 2:
      {
        tft.fillCircle(sx+horLine, sy, gearCircR, TFT_GREEN);
        tft.setCursor(sx+horLine-fntLoff, sy-fntToff);
        tft.setTextColor(BLACK);  tft.setTextSize(1); tft.println("3");
        break;
      }
      case 3:
      {
        tft.fillCircle(sx+horLine, sy+linesWid, gearCircR, TFT_GREEN);
        tft.setCursor(sx+horLine-fntLoff, sy+linesWid-fntToff);
        tft.setTextColor(BLACK);  tft.setTextSize(1); tft.println("4");
        break;
      }
      default: break;
    }
  }
  private:
  int sx, sy;
  int linesWid;
  int horLine;
  int gearCircR;
  int fntLoff=2, fntToff=2;
};

class valBarDisp
{
  public:
  valBarDisp(){}
  ~valBarDisp(){}

  void draw(int val, int MIN, int MAX, int x, int y, int w, int h)
  {
    tft.fillRect(x, y, w, h, TFT_BLACK);
    float DELTA = MAX-MIN;
    float coef = float(w/DELTA);
    float colCoef = float(100/DELTA);
    int BARCOL = int(colCoef*val);
    int BAR = round(coef*val);
    tft.fillRect(x, y, BAR, h, hsv2hex(100-BARCOL, 180, 250));
    //podzialki
    int DIV = w/5;
    for (int i=1; i<DIV-1; i++)
    {
      tft.drawFastVLine( x+i*5, y+1, h-2 ,TFT_BLACK );
      tft.drawFastVLine( x+1+i*5, y+1, h-2 ,TFT_BLACK );
    }
    tft.drawRect(x, y, w, h, TFT_BLUE);
  }
  void drawLikeBat(int val, int MIN, int MAX, int x, int y, int w, int h)
  {
    tft.fillRect(x, y, w, h, TFT_BLACK);
    tft.drawRect(x, y, w, h, TFT_RED);
    tft.drawRect(x+1, y+1, w-2, h-2, TFT_RED);
    tft.fillRect(x+w, y+h/2, 6, -4, TFT_RED);
    tft.fillRect(x+w, y+h/2, 6, 4, TFT_RED);
    float DELTA = MAX-MIN;
    float coef = float(w/DELTA);
    float colCoef = float(100/DELTA);
    int BARCOL = int(colCoef*val);
    int BAR = round(coef*val);
    tft.fillRect(x+2, y+2, BAR-4, h-4, hsv2hex(BARCOL, 180, 250));
    //podzialki
    int DIV = w/5;
    for (int i=1; i<DIV-1; i++)
    {
      tft.drawFastVLine( x+i*5, y+2, h-4 ,TFT_BLACK );
      tft.drawFastVLine( x+1+i*5, y+2, h-4 ,TFT_BLACK );
    }
  }
};

class valBarDispHor
{
  public:
  valBarDispHor(){}
  ~valBarDispHor(){}

  void draw(int val, int MIN, int MAX, int x, int y, int w, int h)
  {
    tft.fillRect(x, y, w, h, TFT_BLACK);
    float DELTA = MAX-MIN;
    float coef = float(h/DELTA);
    float colCoef = float(100/DELTA);
    int BARCOL = int(colCoef*val);
    int BAR = round(coef*val);
    tft.fillRect(x, y+h, w, -BAR, hsv2hex(100-BARCOL, 180, 250));
    //podzialki
    int DIV = h/5;
    for (int i=1; i<DIV; i++)
    {
      tft.drawFastHLine( x+1, y+i*5, w-2 ,TFT_BLACK );
      //tft.drawFastHLine( x+1, y+i*5+1, w-2 ,TFT_BLACK );
    }
    tft.drawRect(x, y, w, h, TFT_YELLOW);
    
  }
};

class sFrame
{
  public:
  sFrame(byte THIK) : thik(THIK) {}
  ~sFrame(){};
  void draw(int x, int y, int w, int h, word col)
  {
    for (int i=0; i<thik; i++)
    tft.drawRect(x+i, y+i, w-2*i, h-2*i, col);
  }
  void clr(int x, int y, int w, int h)
  {
    for (int i=0; i<thik; i++)
    tft.drawRect(x+i, y+i, w-2*i, h-2*i, 0x00);
  }
  private:
  byte thik=2;
};


const unsigned char BRSHimg20x20[] PROGMEM={
0x00, 0x00, 0x00, 0x20, 0x00, 0x00, 0x00, 0x00, 
0x00, 0x00, 0x00, 0x00, 0x00, 0x00, 0x00, 0x00, 
0x00, 0x00, 0x00, 0x00, 0x00, 0x00, 0x00, 0x00, 
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0x00, 0x00, 0x00, 0x00, 0x00, 0x00, 0x00, 0x00
};

const unsigned char SBRSHimg20x20[] PROGMEM ={
0x00, 0x00, 0x00, 0x20, 0x00, 0x00, 0x00, 0x00, 
0x00, 0x00, 0x00, 0x00, 0x00, 0x00, 0x00, 0x00, 
0x00, 0x00, 0x00, 0x00, 0x00, 0x00, 0x00, 0x00, 
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0x00, 0x00, 0x00, 0x00, 0x00, 0x00, 0x00, 0x00
};

const unsigned char BLOWimg20x20[] PROGMEM={
0x00, 0x00, 0x00, 0x20, 0x00, 0x00, 0x00, 0x00, 
0x00, 0x00, 0x00, 0x00, 0x00, 0x00, 0x00, 0x00, 
0x00, 0x00, 0x00, 0x00, 0x00, 0x00, 0x00, 0x00, 
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0x00, 0x00, 0x00, 0x00, 0x00, 0x00, 0x00, 0x00
};
#endif
